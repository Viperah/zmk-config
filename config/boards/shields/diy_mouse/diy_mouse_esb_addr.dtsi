/ {
    esb_split {
        compatible = "zmk,esb-split";
        base-addr-0 = <0x41 0x39 0x95 0x01>;
        base-addr-1 = <0x44 0x49 0x59 0x01>;
        addr-prefix = <0xE7 0xC2 0xC3 0xC4 0xC5 0xC6 0xC7 0xC8>;
    };
};
