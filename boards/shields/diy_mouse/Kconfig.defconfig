## config/Kconfig
```kconfig
menu "DIY Mouse"

config DIY_MOUSE_HALL_BUTTONS
    bool "DIY mouse Hall-effect main buttons"
    depends on ADC
    depends on ZMK_POINTING
    default n
    help
      Poll two ADC Hall sensors and emit left/right mouse button events.

config DIY_MOUSE_HALL_SAMPLE_INTERVAL_US
    int "Hall button sample interval in microseconds"
    depends on DIY_MOUSE_HALL_BUTTONS
    default 1000

config DIY_MOUSE_HALL_BOOT_CALIBRATION_DELAY_MS
    int "Hall button boot calibration delay in milliseconds"
    depends on DIY_MOUSE_HALL_BUTTONS
    default 500

config DIY_MOUSE_HALL_BOOT_CALIBRATION_SAMPLES
    int "Hall button boot calibration samples"
    depends on DIY_MOUSE_HALL_BUTTONS
    default 64

config DIY_MOUSE_HALL_PRESS_DELTA
    int "Hall button press delta from boot baseline"
    depends on DIY_MOUSE_HALL_BUTTONS
    default 60

config DIY_MOUSE_HALL_RELEASE_DELTA
    int "Hall button release delta from boot baseline"
    depends on DIY_MOUSE_HALL_BUTTONS
    default 30

config DIY_MOUSE_HALL_FILTER_SHIFT
    int "Hall button IIR filter shift"
    depends on DIY_MOUSE_HALL_BUTTONS
    default 1
    help
      Applies a light IIR filter: filtered += (raw - filtered) / 2^shift.
      Set to 0 to disable filtering. Higher values are smoother but slower.

config DIY_MOUSE_HALL_PRESS_SAMPLES
    int "Consecutive Hall samples required to press"
    depends on DIY_MOUSE_HALL_BUTTONS
    default 2

config DIY_MOUSE_HALL_RELEASE_SAMPLES
    int "Consecutive Hall samples required to release"
    depends on DIY_MOUSE_HALL_BUTTONS
    default 2

config DIY_MOUSE_HALL_INPUT_SPLIT_REG
    int "ESB input-split register for Hall mouse buttons"
    depends on DIY_MOUSE_HALL_BUTTONS
    default 2

config DIY_MOUSE_CPI_CYCLE
    bool "DIY mouse PAW3395 CPI cycle behavior"
    depends on PAW3395
    default n
    help
      Adds a keymap behavior that cycles the PAW3395 CPI setting.

endmenu
```

## config/boards/shields/diy_mouse/Kconfig.defconfig
```kconfig
if SHIELD_DIY_MOUSE

config ZMK_KEYBOARD_NAME
    default "DIY Mouse"

endif

if SHIELD_DIY_MOUSE_ESB_MOUSE

config ZMK_KEYBOARD_NAME
    default "DIY Mouse ESB"

config ZMK_SPLIT
    default y

endif

if SHIELD_DIY_MOUSE_ESB_DONGLE

config ZMK_KEYBOARD_NAME
    default "DIY Mouse Dongle"

config ZMK_SPLIT
    default y

config ZMK_SPLIT_ROLE_CENTRAL
    default y

endif
```

## config/boards/shields/diy_mouse/Kconfig.shield
```kconfig
config SHIELD_DIY_MOUSE
    def_bool $(shields_list_contains,diy_mouse)

config SHIELD_DIY_MOUSE_ESB_MOUSE
    def_bool $(shields_list_contains,diy_mouse_esb_mouse)

config SHIELD_DIY_MOUSE_ESB_DONGLE
    def_bool $(shields_list_contains,diy_mouse_esb_dongle)
```

## config/dts/bindings/behaviors/diy,behavior-cpi-cycle.yaml
```yaml
description: Cycle the PAW3395 CPI setting

compatible: "diy,behavior-cpi-cycle"

include: zero_param.yaml
```

## config/dts/bindings/input/diy,mouse-digital-buttons.yaml
```yaml
# Copyright (c) 2026
# SPDX-License-Identifier: MIT

description: DIY mouse normal button input device.

compatible: "diy,mouse-digital-buttons"

include: base.yaml

properties:
  input-gpios:
    type: phandle-array
    required: true
  button-codes:
    type: array
    required: true
  dpi-gpios:
    type: phandle-array
    required: true
```

## config/dts/bindings/input/diy,mouse-hall-buttons.yaml
```yaml
# Copyright (c) 2026
# SPDX-License-Identifier: MIT

description: DIY mouse Hall-effect button input device.

compatible: "diy,mouse-hall-buttons"

include: base.yaml
```

## config/dts/bindings/input/diy,mouse-scroll-wheel.yaml
```yaml
# Copyright (c) 2026
# SPDX-License-Identifier: MIT

description: DIY mouse quadrature scroll wheel input device.

compatible: "diy,mouse-scroll-wheel"

include: base.yaml

properties:
  a-gpios:
    type: phandle-array
    required: true
  b-gpios:
    type: phandle-array
    required: true
```

## config/west.yml
```yaml
manifest:
  remotes:
    - name: zmkfirmware
      url-base: https://github.com/zmkfirmware
    - name: badjeff
      url-base: https://github.com/badjeff
    - name: nrfconnect
      url-base: https://github.com/nrfconnect

  projects:
    - name: zmk
      remote: zmkfirmware
      revision: main
      import: app/west.yml
    - name: zmk-feature-split-esb
      remote: badjeff
      revision: 02d790c4f8279f4ece6ba481b42ff2b8060bcd88
    - name: sdk-nrf
      remote: badjeff
      revision: v3.1-branch+zmk-fixes
      path: nrf
    - name: nrfxlib
      remote: nrfconnect
      revision: v3.1-branch
      repo-path: sdk-nrfxlib
      path: nrfxlib
    - name: zmk-paw3395-driver
      remote: badjeff
      revision: 0bbdb875864d10dec1480cd380d9d48bb16945ef

  self:
    path: config
```
